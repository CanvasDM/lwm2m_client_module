## Kconfig
```kconfig
#
# Copyright (c) 2022 Laird Connectivity LLC
#
# SPDX-License-Identifier: LicenseRef-LairdConnectivity-Clause
#
menuconfig LCZ_LWM2M_CLIENT
	bool "LCZ LwM2M Client"
	depends on LCZ_LWM2M

if LCZ_LWM2M_CLIENT

module=LCZ_LWM2M_CLIENT
module-str=LCZ_LWM2M_CLIENT
source "subsys/logging/Kconfig.template.log_config"

config LCZ_LWM2M_CLIENT_INIT_PRIORITY
    int "Init priority Application for LwM2M client module"
    range 0 99
    default APPLICATION_INIT_PRIORITY
    help
      Recommended to be higher than main thread init priority.

config LCZ_LWM2M_CLIENT_ENDPOINT_NAME
	string "Endpoint name"
	default "my_device"
	help
	  Endpoint name used by the application for starting a connection.

config LCZ_LWM2M_CLIENT_REBOOT_DELAY_SECONDS
	int "Delay before reboot (seconds)"
	default 5
	help
	  If the user does not override the reboot callback
	  (lcz_lwm2m_client_register_reboot_callback), this is the delay
	  used before a reboot is initiated.

config LCZ_LWM2M_CLIENT_ENABLE_ATTRIBUTES
	bool "Enable attributes"
	depends on ATTR
	help
	  Enable attributes system for LwM2M client settings.

choice
	prompt "Client init mode"
	default LCZ_LWM2M_CLIENT_INIT_KCONFIG

config LCZ_LWM2M_CLIENT_INIT_KCONFIG
	bool "Kconfig"
	help
	  Use Kconfig settings to init client.

config LCZ_LWM2M_CLIENT_INIT_ATTRIBUTES
	bool "Attributes"
	depends on ATTR
	select LCZ_LWM2M_CLIENT_ENABLE_ATTRIBUTES
	help
	  Use attributes system to init client.

endchoice

config LCZ_LWM2M_TRANSPORT_BLE_PERIPHERAL
    bool "Enable transport of LwM2M by a BLE peripheral device"
	depends on LCZ_BT
	depends on EVENTFD
	depends on BT_PERIPHERAL
	depends on MCUMGR_SMP_BT

if LCZ_LWM2M_TRANSPORT_BLE_PERIPHERAL

config LCZ_LWM2M_TRANSPORT_BLE_SMP_GROUP
	int "SMP group ID for BLE LwM2M transport"
	default 5683

endif # LCZ_LWM2M_TRANSPORT_BLE_PERIPHERAL

if LCZ_LWM2M_CLIENT_INIT_KCONFIG

if LCZ_LWM2M_TRANSPORT_UDP

config LCZ_LWM2M_SERVER_URL
	string "Server URL"
	default "coap://lwm2m.com"

config LCZ_LWM2M_SECURITY_MODE
	int "Security mode"
	range 0 4
	default 3
	help
	  0 - PSK
	  1 - RPK
	  2 - Certificate
	  3 - No Security
	  4 - Certificate with EST

config LCZ_LWM2M_TLS_TAG
	int "TLS tag for secure connection"
	depends on LCZ_LWM2M_DTLS_SUPPORT
	default 999
	range 0 65535

config LCZ_LWM2M_PSK_ID
	string "PSK ID"
	default "my_psk"
	help
	  Pre-shared key identity

config LCZ_LWM2M_PSK
	string "PSK"
	default "000102030405060708090a0b0c0d0e0f"
	help
	  PSK as a HEX string. This string will be converted to binary and
	  used as the PSK.
	  Length of this string needs to be LCZ_LWM2M_SECURITY_KEY_SIZE.

endif # LCZ_LWM2M_TRANSPORT_UDP

config LCZ_LWM2M_BOOTSTRAP_SETTING
	int "Bootstrap setting"
	range 0 1
	default 0
	help
	  0 - disabled
	  1 - enabled

config LCZ_LWM2M_SHORT_SERVER_ID
	int "Short server ID"
	range 1 65534
	default 1

endif # LCZ_LWM2M_CLIENT_INIT_KCONFIG

choice
	prompt "Device settings init mode"
	default LCZ_LWM2M_CLIENT_DEVICE_NO_INIT
	help
	  Init object 3 device settings

config LCZ_LWM2M_CLIENT_DEVICE_NO_INIT
	bool "Do not init"
	help
	  Do not init device settings. Use this option to not init optional
	  device (object 3) settings. This saves RAM.

config LCZ_LWM2M_CLIENT_DEVICE_INIT_KCONFIG
	bool "Kconfig"
	help
	  Use Kconfig settings to init device settings.

config LCZ_LWM2M_CLIENT_DEVICE_INIT_ATTRIBUTES
	bool "Attributes"
	depends on ATTR
	select LCZ_LWM2M_CLIENT_ENABLE_ATTRIBUTES
	help
	  Use attributes system to init device settings.

endchoice

if LCZ_LWM2M_CLIENT_DEVICE_INIT_KCONFIG

config LCZ_LWM2M_CLIENT_DEVICE_MFG
	string "Manufacturer"
	default "Laird Connectivity"
	help
	  Device manufacturer

config LCZ_LWM2M_CLIENT_DEVICE_MN
	string "Model number"
	default "MG100"
	help
	  Device model number

config LCZ_LWM2M_CLIENT_DEVICE_SN
	string "Serial number"
	default "SN0001"
	help
	  Device serial number

config LCZ_LWM2M_CLIENT_DEVICE_FW_VER
	string "Firmware version"
	default "0.0.0"
	help
	  Device firmware version

config LCZ_LWM2M_CLIENT_DEVICE_PWR_SRC
	int "Power source"
	range 0 7
	default 0
	help
	  Device power source. This sets resource 6 instance 0 (3/0/6/0).
	  Other instances need to be managed at runtime.
	  0: DC power
	  1: Internal Battery
	  2: External Battery
	  3: Fuel Cell
	  4: Power over Ethernet
	  5: USB
	  6: AC (Mains) power
	  7: Solar

config LCZ_LWM2M_CLIENT_DEVICE_PWR_SRC_VOLT
	int "Power source voltage"
	default 0
	help
	  Device power source voltage in millivolts (mV). This sets
	  resource 7 instance 0 (3/0/7/0).
	  Other instances need to be managed at runtime.

config LCZ_LWM2M_CLIENT_DEVICE_SW_VER
	string "Software version"
	default "0.0.0"
	help
	  Device software version

config LCZ_LWM2M_CLIENT_DEVICE_HW_VER
	string "Hardware version"
	default "0.0.0"
	help
	  Device hardware version

config LCZ_LWM2M_CLIENT_DEVICE_BATT_STAT
	int "Battery status"
	range 0 6
	default 6
	help
	  Device battery status:
	  0 Normal - The battery is operating normally and not on power.
	  1 Charging - The battery is currently charging.
	  2 Charge Complete - The battery is fully charged and still on power.
	  3 Damaged - The battery has some problem.
	  4 Low Battery - The battery is low on charge.
	  5 Not Installed - The battery is not installed.
	  6 Unknown - The battery information is not available.

endif # LCZ_LWM2M_CLIENT_DEVICE_INIT_KCONFIG

endif # LCZ_LWM2M_CLIENT
```
